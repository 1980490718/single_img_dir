## IPQ4019.ILQ.5.0/common/build/ipq/flash.its
```
/dts-v1/;

/ {
        description = "Flashing nor 100 10000";
        images {

                script {
                        description = "flash.scr";
                        data = /incbin/("./flash.scr");
                        type = "script";
                        arch = "arm";
                        compression = "none";
                        hash@1 { algo = "crc32"; };
                };

                hlos-53539d83da18934c8061780cd147de42a4c0c055 {
                        description = "openwrt-ipq806x-qcom-ipq40xx-ap.dkxx-fit-uImage.itb";
                        data = /incbin/("./openwrt-ipq806x-qcom-ipq40xx-ap.dkxx-fit-uImage.itb");
                        type = "firmware";
                        arch = "arm";
                        compression = "none";
                        hash@1 { algo = "crc32"; };
                };

                rootfs-73be11f50c9325ae68c43b1ae01663c947d14314 {
                        description = "openwrt-ipq806x-squashfs-root.img";
                        data = /incbin/("./openwrt-ipq806x-squashfs-root.img");
                        type = "firmware";
                        arch = "arm";
                        compression = "none";
                        hash@1 { algo = "crc32"; };
                };

        };
};
```
